## tests/lib/hexascii/testcase.yaml
```yaml
tests:
  lib.hexascii:
    harness: ztest
    platform_allow:
      - native_sim
    timeout: 10
    tags:
      - unit
      - hexascii
  
```

## tests/lib/qrcode/testcase.yaml
```yaml
tests:
  lib.qrcode:
    harness: ztest
    platform_allow:
      - native_sim
    timeout: 10
    tags:
      - generic
      - unit
      - qrcode
  
```

## west.yml
```yaml
manifest:
  self:
    west-commands: scripts/west-commands.yml

  remotes:
    - name: zephyrproject-rtos
      url-base: https://github.com/zephyrproject-rtos

  projects:
    - name: zephyr
      remote: zephyrproject-rtos
      revision: 69f3a442708eb2b4429298b72cbb2a5ba99125ff
      import:
        name-allowlist:
          - cmsis_6
          - hal_stm32
          - segger
```
